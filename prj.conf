## CMakeLists.txt
```
# SPDX-License-Identifier: Apache-2.0

cmake_minimum_required(VERSION 3.20.0)

set_property(GLOBAL APPEND PROPERTY HEX_FILES_TO_MERGE
      ${app_provision_hex})

# build PCA10040 board
set(BOARD nrf52dk_nrf52832)

# build PCA10028 board
#set(BOARD nrf51dk_nrf51422)

find_package(Zephyr)
project(nordic_uart)

target_sources(app PRIVATE src/main.c)
target_sources(app PRIVATE src/nus.c)

target_include_directories(app PRIVATE src)

# zephyr_compile_options(-save-temps)
```

## prj.conf
```kconfig
CONFIG_BT=y
CONFIG_BT_SMP=y
CONFIG_RESET=n

CONFIG_BT_GATT_DYNAMIC_DB=y

CONFIG_BT_TINYCRYPT_ECC=y
CONFIG_BT_PERIPHERAL=y
CONFIG_BT_DEVICE_NAME="Zephyr_UART"
CONFIG_BT_DEVICE_APPEARANCE=833

CONFIG_PRINTK=y

CONFIG_USE_SEGGER_RTT=y
CONFIG_SEGGER_RTT_MAX_NUM_UP_BUFFERS=3
CONFIG_SEGGER_RTT_MAX_NUM_DOWN_BUFFERS=3
CONFIG_SEGGER_RTT_BUFFER_SIZE_UP=1024
CONFIG_SEGGER_RTT_BUFFER_SIZE_DOWN=16
CONFIG_SEGGER_RTT_PRINTF_BUFFER_SIZE=64
CONFIG_SEGGER_RTT_MODE_NO_BLOCK_SKIP=y

CONFIG_LOG_BACKEND_RTT=y
CONFIG_LOG_BACKEND_RTT_MODE_BLOCK=y
CONFIG_LOG_BACKEND_RTT_OUTPUT_BUFFER_SIZE=16
CONFIG_LOG_BACKEND_RTT_RETRY_CNT=4
CONFIG_LOG_BACKEND_RTT_RETRY_DELAY_MS=5
CONFIG_LOG_BACKEND_RTT_BUFFER=0

CONFIG_LOG=y
CONFIG_LOG_DEFAULT_LEVEL=3
CONFIG_LOG_OVERRIDE_LEVEL=0
CONFIG_LOG_MAX_LEVEL=4
CONFIG_LOG_FUNC_NAME_PREFIX_DBG=y

CONFIG_LOG_PRINTK=y
CONFIG_LOG_MODE_OVERFLOW=y
CONFIG_LOG_PROCESS_TRIGGER_THRESHOLD=10
CONFIG_LOG_PROCESS_THREAD=y
CONFIG_LOG_PROCESS_THREAD_SLEEP_MS=1000
CONFIG_LOG_PROCESS_THREAD_STACK_SIZE=768
CONFIG_LOG_BUFFER_SIZE=6144

CONFIG_LOG_BACKEND_SHOW_COLOR=n
```

## src/main.c
```c
/** @file
 *  @brief Nordic NUS sample application (Nordic Uart Service)
 */

/*
 * Copyright (c) 2018 Nordic Semiconductor ASA
 * Copyright (c) 2020 Callender-Consulting LLC
 *
 * SPDX-License-Identifier: Apache-2.0
 */
#include <stddef.h>
#include <string.h>
#include <errno.h>

#include <zephyr/kernel.h>
#include <zephyr/types.h>
#include <zephyr/sys/printk.h>
#include <zephyr/sys/byteorder.h>
#include <zephyr/bluetooth/bluetooth.h>
#include <zephyr/bluetooth/hci.h>

#include "nus.h"

#define LOG_LEVEL 3
#include <zephyr/logging/log.h>
LOG_MODULE_REGISTER(main);

/* AUTH_NUMERIC_COMPARISON result in in LESC Numeric Comparison authentication
 * Undefine this result in LESC Passkey Input
 */
#define AUTH_NUMERIC_COMPARISON

#define DEVICE_NAME         CONFIG_BT_DEVICE_NAME
#define DEVICE_NAME_LEN     (sizeof(DEVICE_NAME) - 1)

struct bt_conn *default_conn;
    /** Level 0: Only for BR/EDR special cases, like SDP */
    /** Level 1: No encryption and no authentication. */
    /** Level 2: Encryption and no authentication (no MITM). */
    /** Level 3: Encryption and authentication (MITM). */
    /** Level 4: Authenticated Secure Connections and 128-bit key. */
#define BT_SECURITY     BT_SECURITY_L1
bt_security_t           g_level = BT_SECURITY_L1;

static const struct bt_data ad[] = {
    BT_DATA_BYTES(BT_DATA_FLAGS, (BT_LE_AD_GENERAL | BT_LE_AD_NO_BREDR)),
    BT_DATA_BYTES(BT_DATA_UUID128_ALL, 0x9E, 0xCA, 0xDC, 0x24, 0x0E, 0xE5, 0xA9, 0xE0, 0x93, 0xF3, 0xA3, 0xB5, 0x01, 0x00, 0x40, 0x6E),
};

static const struct bt_data sd[] = {
    BT_DATA(BT_DATA_NAME_COMPLETE, DEVICE_NAME, DEVICE_NAME_LEN),
};

static void connected(struct bt_conn *conn, uint8_t err)
{
    if (err) {
        LOG_ERR("Connection failed (err %u)", err);
    } 

    default_conn = bt_conn_ref(conn);
    LOG_INF("Connected");

    int ret = bt_conn_set_security(default_conn, BT_SECURITY);
    if (ret) {
        LOG_ERR("Failed to set security (err %d)", ret);
    }
}

static void disconnected(struct bt_conn *conn, uint8_t reason)
{
    LOG_INF("Disconnected (reason %u)", reason);

    if (default_conn) {
        bt_conn_unref(default_conn);
        default_conn = NULL;
    }
}

#if defined(CONFIG_BT_SMP)
static void identity_resolved(struct bt_conn *conn, const bt_addr_le_t *rpa, const bt_addr_le_t *identity)
{
    char addr_identity[BT_ADDR_LE_STR_LEN];
    char addr_rpa[BT_ADDR_LE_STR_LEN];

    LOG_INF("%s", __func__);

    bt_addr_le_to_str(identity, addr_identity, sizeof(addr_identity));
    bt_addr_le_to_str(rpa, addr_rpa, sizeof(addr_rpa));

    LOG_INF("Identity resolved %s -> %s", addr_rpa, addr_identity);
}

static void security_changed(struct bt_conn *conn, bt_security_t level, enum bt_security_err err)
{
    char addr[BT_ADDR_LE_STR_LEN];

    LOG_INF("%s", __func__);

    if (err) {
        LOG_ERR("%s failed: %d", __func__, err);
        return;
    }

    bt_addr_le_to_str(bt_conn_get_dst(conn), addr, sizeof(addr));

    LOG_INF("Security changed: %s level %u", addr, level);
    g_level = level;
}
#endif /* defined(CONFIG_BT_SMP) */

static struct bt_conn_cb conn_callbacks = {
    .connected          = connected,
    .disconnected       = disconnected,
    .le_param_req       = NULL,
    .le_param_updated   = NULL,
#if defined(CONFIG_BT_SMP)
    .identity_resolved  = identity_resolved,
    .security_changed   = security_changed
#endif /* defined(CONFIG_BT_SMP) */
};

static void nus_data_handler(ble_nus_data_evt_t * p_evt)
{
   LOG_INF("NUS data received, len: %d, data: %s\n", 
           p_evt->rx_data.length, p_evt->rx_data.p_data);
}

static void bt_ready(int err)
{
    ble_nus_init_t init = {
      .data_handler = nus_data_handler
    };
     
    if (err) {
        LOG_ERR("Bluetooth init failed (err %d)", err);
        return;
    }

    LOG_INF("Bluetooth initialized");

    err = nus_init(&init);
    if (err) {
        LOG_ERR("NUS failed to init (err %d)", err);
        return;
    }

    err = bt_le_adv_start(BT_LE_ADV_CONN, ad, ARRAY_SIZE(ad), sd, ARRAY_SIZE(sd));
    if (err) {
        LOG_ERR("Advertising failed to start (err %d)", err);
        return;
    }

    LOG_INF("Advertising successfully started");
}

static void auth_cancel(struct bt_conn *conn)
{
    char addr[BT_ADDR_LE_STR_LEN];

    bt_addr_le_to_str(bt_conn_get_dst(conn), addr, sizeof(addr));

    bt_conn_auth_cancel(conn);
    LOG_INF("Pairing cancelled: %s", addr);
}

static void auth_pairing_confirm(struct bt_conn *conn)
{
    char addr[BT_ADDR_LE_STR_LEN];
    int err;

    bt_addr_le_to_str(bt_conn_get_dst(conn), addr, sizeof(addr));

    LOG_INF("Pairing Confirm for %s", addr);
    if (conn == default_conn) {
        err = bt_conn_auth_pairing_confirm(conn);
        if (err) {
            LOG_ERR("Confirm failed(err %d)", err);
        }
        else {
            LOG_INF("Confirmed!");
        }
    }
}

static void auth_passkey_display(struct bt_conn *conn, unsigned int passkey)
{
    char addr[BT_ADDR_LE_STR_LEN];

    bt_addr_le_to_str(bt_conn_get_dst(conn), addr, sizeof(addr));

    LOG_INF("Passkey Display for %s: %06u", addr, passkey);
}

#if defined(AUTH_NUMERIC_COMPARISON)
static void auth_passkey_confirm(struct bt_conn *conn, unsigned int passkey)
{
    char addr[BT_ADDR_LE_STR_LEN];
    int err;

    bt_addr_le_to_str(bt_conn_get_dst(conn), addr, sizeof(addr));
    LOG_INF("Passkey Confirm for %s: %06u", addr, passkey);
    if (conn == default_conn) {
        err = bt_conn_auth_passkey_confirm(conn);
        if (err) {
            LOG_ERR("Confirm failed(err %d)", err);
        }
        else {
            LOG_INF("Confirmed!");
        }
    }
}

/* result in DISPLAY_YESNO and Numeric Comparison
 * check bt_conn_get_io_capa() in subsys/bluetooth/host/conn.c
 */
static struct bt_conn_auth_cb auth_cb_display_yesno = {
    .passkey_display    = auth_passkey_display,
    .passkey_entry      = NULL,
    .passkey_confirm    = auth_passkey_confirm,
    .cancel             = auth_cancel,
    .pairing_confirm    = auth_pairing_confirm
};

#else
/* result in DISPLAY_ONLY and Passkey Input
 * check bt_conn_get_io_capa() in subsys/bluetooth/host/conn.c
 */
static struct bt_conn_auth_cb auth_cb_display_only = {
    .passkey_display    = auth_passkey_display,
    .passkey_entry      = NULL,
    .passkey_confirm    = NULL,
    .cancel             = auth_cancel,
    .pairing_confirm    = auth_pairing_confirm
};
#endif

void main(void)
{
    int err;
    char tx_char;
    int tx_index = 0;

    err = bt_enable(bt_ready);
    if (err) {
        LOG_ERR("Bluetooth init failed (err %d)", err);
        return;
    }

    bt_conn_cb_register(&conn_callbacks);

#if defined(AUTH_NUMERIC_COMPARISON)
    bt_conn_auth_cb_register(&auth_cb_display_yesno);
#else
    bt_conn_auth_cb_register(&auth_cb_display_only);
#endif

    /* Implement notification. At the moment there is no suitable way
     * of starting delayed work so we do it here
     */
    while (1) {
        k_sleep(K_MSEC(1000));

        tx_char = 'A' + tx_index % 26;
        /* Send NUS notifications */
        if (g_level == BT_SECURITY && nus_notify(default_conn, tx_char) == 0)
        {
           LOG_INF("NUS sent %c", tx_char);
           tx_index++;
        }
    }
}
```

## src/nus.c
```c
/** @file
 *  @brief Nordic NUS Service  (Nordic Uart Service)
 */

/*
 * Copyright (c) 2018 Nordic Semiconductor ASA
 * Copyright (c) 2020 Callender-Consulting LLC
 *
 * SPDX-License-Identifier: Apache-2.0
 */
#include <stddef.h>
#include <string.h>
#include <errno.h>

#include <zephyr/kernel.h>
#include <zephyr/types.h>
#include <zephyr/sys/printk.h>
#include <zephyr/sys/byteorder.h>
#include <zephyr/bluetooth/bluetooth.h>
#include <zephyr/bluetooth/hci.h>
#include <zephyr/bluetooth/conn.h>
#include <zephyr/bluetooth/gatt.h>
#include <zephyr/bluetooth/uuid.h>

#include "nus.h"

#define LOG_LEVEL 3
#include <zephyr/logging/log.h>
LOG_MODULE_REGISTER(nus);

static uint8_t nus_rx[26];
static uint8_t nus_tx_started;
static ble_nus_init_t ble_nus = {
    .data_handler = NULL
};

static void nus_ccc_cfg_changed(const struct bt_gatt_attr *attr, uint16_t value)
{
    LOG_ERR("%s: value: %d", __func__, value);

    nus_tx_started = (value == BT_GATT_CCC_NOTIFY) ? 1 : 0;
}

static ssize_t on_write_rx(struct bt_conn *conn, const struct bt_gatt_attr *attr,
                           const void *buf, uint16_t len, uint16_t offset, uint8_t flags)
{
    uint8_t * value = attr->user_data;

    if (offset + len > sizeof(nus_rx)) {
        LOG_ERR("%s: INVALID OFFSET: offset(%d) + len(%d) > sizeof(nus_rx) %d ", 
                __func__, offset, len, sizeof(nus_rx));
        return BT_GATT_ERR(BT_ATT_ERR_INVALID_OFFSET);
    }

    memcpy(value + offset, buf, len);

    if (ble_nus.data_handler != NULL) {
       ble_nus_data_evt_t evt;

       evt.conn             = conn;
       evt.rx_data.length   = len;
       evt.rx_data.p_data   = value;
       ble_nus.data_handler(&evt);
    }

    return len;
}

static ssize_t on_read_rx(struct bt_conn *conn, const struct bt_gatt_attr *attr,
                            void *buf, uint16_t len, uint16_t offset)
{
    LOG_INF("%s", __func__);
    return bt_gatt_attr_read(conn, attr, buf, len, offset, &nus_rx, sizeof(nus_rx));
}

/* NUS Service Declaration */
static struct bt_gatt_attr attrs[] = {
    BT_GATT_PRIMARY_SERVICE(BT_UUID_NUS),

    /* RX */
    BT_GATT_CHARACTERISTIC(BT_UUID_NUS_RX, 
                           BT_GATT_CHRC_WRITE | BT_GATT_CHRC_WRITE_WITHOUT_RESP,
                           BT_GATT_PERM_READ  | BT_GATT_PERM_WRITE, 
                           on_read_rx, on_write_rx, &nus_rx),

    /* TX */    
    BT_GATT_CHARACTERISTIC(BT_UUID_NUS_TX,
                           BT_GATT_CHRC_NOTIFY,
                           BT_GATT_PERM_NONE,
                           NULL, NULL, NULL),

    BT_GATT_CCC(nus_ccc_cfg_changed, BT_GATT_PERM_READ | BT_GATT_PERM_WRITE),
};

static struct bt_gatt_service nus_svc = BT_GATT_SERVICE(attrs);

int32_t nus_init(ble_nus_init_t *p_init)
{
    if (p_init->data_handler == NULL) {
        return -1;
    }
    else {
        ble_nus.data_handler = p_init->data_handler;
    }

    return bt_gatt_service_register(&nus_svc);
}

int32_t nus_notify(struct bt_conn *conn, uint8_t tx)
{
    uint8_t tx_char = tx;
    
    if (!nus_tx_started) {
        return -1;
    }

    return bt_gatt_notify(conn, &attrs[4], &tx_char, sizeof(tx_char));
}
```

## src/nus.h
```c
/** @file
 *  @brief Nordic NUS Service  (Nordic Uart Service)
 */

/*
 * Copyright (c) 2018 Nordic Semiconductor ASA
 * Copyright (c) 2020 Callender-Consulting LLC
 *
 * SPDX-License-Identifier: Apache-2.0
 */
#ifndef __NVS_H
#define __NVS_H

#include <zephyr/bluetooth/conn.h>
#include <zephyr/bluetooth/uuid.h>

/** @def BT_UUID_NUS
 *  @brief Nordic UART Service
 */
#define BT_UUID_NUS            BT_UUID_DECLARE_128(0x9E, 0xCA, 0xDC, 0x24, 0x0E, 0xE5, 0xA9, 0xE0, 0x93, 0xF3, 0xA3, 0xB5, 0x01, 0x00, 0x40, 0x6E)
/** @def BT_UUID_NUS_RX
 *  @brief NUS RX Service
 */
#define BT_UUID_NUS_RX         BT_UUID_DECLARE_128(0x9E, 0xCA, 0xDC, 0x24, 0x0E, 0xE5, 0xA9, 0xE0, 0x93, 0xF3, 0xA3, 0xB5, 0x02, 0x00, 0x40, 0x6E)
/** @def BT_UUID_NUS_TX
 *  @brief NUS TX Service
 */
#define BT_UUID_NUS_TX         BT_UUID_DECLARE_128(0x9E, 0xCA, 0xDC, 0x24, 0x0E, 0xE5, 0xA9, 0xE0, 0x93, 0xF3, 0xA3, 0xB5, 0x03, 0x00, 0x40, 0x6E)

/**@brief   Nordic UART Service @ref BLE_NUS_EVT_RX_DATA event data.
 *
 * @details This structure is passed to an event when @ref BLE_NUS_EVT_RX_DATA occurs.
 */
typedef struct
{
    uint8_t const * p_data; /**< A pointer to the buffer with received data. */
    uint16_t        length; /**< Length of received data. */
} ble_nus_evt_rx_data_t;


/**@brief   Nordic UART Service data event structure.
 *
 * @details This structure is passed to an event coming from service.
 */
typedef struct
{
    struct bt_conn  *conn;     /**< Connection referencee. */
    ble_nus_evt_rx_data_t    rx_data;   /**< @ref BLE_NUS_EVT_RX_DATA event data. */
} ble_nus_data_evt_t;


/**@brief Nordic UART Service event handler type. */
typedef void (* ble_nus_data_handler_t) (ble_nus_data_evt_t * p_evt);


/**@brief   Nordic UART Service initialization structure.
 *
 * @details This structure contains the initialization information for the service. The application
 * must fill this structure and pass it to the service using the @ref ble_nus_init
 *          function.
 */
typedef struct
{
    ble_nus_data_handler_t data_handler; /**< Event handler to be called for handling received data. */
} ble_nus_init_t;

 
#ifdef __cplusplus
extern "C" {
#endif

int32_t nus_init(ble_nus_init_t *p_init);
int32_t nus_notify(struct bt_conn *conn, uint8_t tx);

#ifdef __cplusplus
}
#endif

#endif /* __NVS_H */ 
```
